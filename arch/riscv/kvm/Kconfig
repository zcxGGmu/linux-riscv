## arch/riscv/kvm/Kconfig
```kconfig
# SPDX-License-Identifier: GPL-2.0
#
# KVM configuration
#

source "virt/kvm/Kconfig"

menuconfig VIRTUALIZATION
	bool "Virtualization"
	help
	  Say Y here to get to see options for using your Linux host to run
	  other operating systems inside virtual machines (guests).
	  This option alone does not add any kernel code.

	  If you say N, all options in this submenu will be skipped and
	  disabled.

if VIRTUALIZATION

config KVM
	tristate "Kernel-based Virtual Machine (KVM) support (EXPERIMENTAL)"
	depends on RISCV_SBI && MMU
	select HAVE_KVM_IRQCHIP
	select HAVE_KVM_IRQ_ROUTING
	select HAVE_KVM_MSI
	select HAVE_KVM_VCPU_ASYNC_IOCTL
	select HAVE_KVM_READONLY_MEM
	select KVM_COMMON
	select KVM_GENERIC_DIRTYLOG_READ_PROTECT
	select KVM_GENERIC_HARDWARE_ENABLING
	select KVM_MMIO
	select KVM_XFER_TO_GUEST_WORK
	select KVM_GENERIC_MMU_NOTIFIER
	select SCHED_INFO
	help
	  Support hosting virtualized guest machines.

	  If unsure, say N.

config PTDUMP_GSTAGE_DEBUGFS
       bool "Present the G-stage pagetables to debugfs"
       depends on KVM
       select PTDUMP_CORE
       default n
       help
         Say Y here if you want to show the G-stage kernel pagetables
         layout in a debugfs file. This information is only useful for
		 kernel developers who are working in architecture specific areas
		 of the kernel. It is probably not a good idea to enable this
		 feature in a production kernel.

         If in doubt, say N.

endif # VIRTUALIZATION
```
